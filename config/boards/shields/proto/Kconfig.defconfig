## config/boards/shields/proto/Kconfig.defconfig
```kconfig
if SHIELD_PROTO_LEFT

config ZMK_KEYBOARD_NAME
    default "Proto"

config ZMK_SPLIT_ROLE_CENTRAL
    default y

endif

if SHIELD_PROTO_RIGHT

config ZMK_KEYBOARD_NAME
    default "Proto_R"

config SPI
    default y

endif

if SHIELD_PROTO_LEFT || SHIELD_PROTO_RIGHT

config ZMK_SPLIT
    default y

config ZMK_POINTING
    default y

endif
```

## config/boards/shields/proto/Kconfig.shield
```kconfig
config SHIELD_PROTO
    def_bool $(shields_list_contains,proto)

config SHIELD_PROTO_LEFT
    def_bool $(shields_list_contains,proto_left)

config SHIELD_PROTO_RIGHT
    def_bool $(shields_list_contains,proto_right)
```

## config/west.yml
```yaml
manifest:
  remotes:
    - name: zmkfirmware
      url-base: https://github.com/zmkfirmware
    - name: cirque_trackpad
      url-base: https://github.com/petejohanson
  projects:
    - name: zmk
      remote: zmkfirmware
      revision: main
      import: app/west.yml
    - name: cirque-input-module
      revision: main
      remote: cirque_trackpad
  self:
    path: config
```
